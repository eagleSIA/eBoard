//This was created by EagleoutIce 'document creator: create_doc' using doxygen 1.8.15 and python 3.5.2
//Created: 22.06.2018 00:28:46
#ifndef EAGLE_EBOARD_HELPLIB_LCD
  #define EAGLE_EBOARD_HELPLIB_LCD

    


//=====================================================================================================================================================
//                                                                       Memory                                                                        
//=====================================================================================================================================================


  PROGMEM const byte basicFont[][8] = {
    {0x00,0x00,0x00,0x00,0x00,0x00,0x00,0x00},
    {0x00,0x00,0x5F,0x00,0x00,0x00,0x00,0x00},
    {0x00,0x00,0x07,0x00,0x07,0x00,0x00,0x00},
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    {0x00,0x02,0x05,0x05,0x02,0x00,0x00,0x00}
  };

//=====================================================================================================================================================
//                                                                  Macro Definitions                                                                  
//=====================================================================================================================================================

  //Definition of OLED Constants
  

  #define LCD_COMMAND_MODE                0x80
  

  #define LCD_DATA_MODE                   0x40
  

  #define LCD_COMMAND_DISPLAY_OFF         0xAE
  

  #define LCD_COMMAND_DISPLAY_ON          0xAF
  

  #define LCD_COMMAND_BLACK_BACKGROUND    0xA6
  

  #define LCD_COMMAND_WHITE_BACKGROUND    0xA7
  

  #define LCD_COMMAND_SET_BRIGHTNESS      0x81
  

  #define LCD_PAGE_ADDRESSING	            0x02
  

  #define LCD_HORIZONTAL_ADDRESSING       0x00
  //The regulator
  

  #define LCD_COMMAND_CHARGE_PUMP_SETTING	0x8d
  

  #define LCD_COMMAND_CHARGE_PUMP_ENABLE 0x14

  #ifndef LCD_WIDTH
      

      #define LCD_WIDTH 128
  #endif
  #ifndef LCD_HEIGHT
      

      #define LCD_HEIGHT 64
  #endif

//=====================================================================================================================================================
//                                                                         LCD                                                                         
//=====================================================================================================================================================

    //-------------------------------------------------------------------------------------------------------------------------------------------------
    //                                                                    class                                                                        
    //-------------------------------------------------------------------------------------------------------------------------------------------------

  

  struct LCD {
      #if EBOARD_NANO == 0
      

      LCD(SoccerBoard &soccerBoard, optVAL_t id=0x3C);
      #else
      LCD(optVAL_t id=0x3C);
      #endif
      

      bool changeID(optVAL_t newID = 0x3C);
      

      bool clear(void);
      

      void print(const char* data);
      

      void print(int data);
      

      void print(optVAL_t line, optVAL_t col, const char* data);
      

      void print(optVAL_t line, optVAL_t col, int data);
     

      inline void lightOn(void);
      

      inline void lightOff(void);
      

      bool reset(void);

      //added features
      

      bool init(void);
      

      void drawBitmap(const unsigned char *bitmap, byte posX, byte posY, byte hiX, byte hiY);
      

      void changeMode(bool newMode = true);
      

      bool setCursor(byte posX = 0x0, byte posY = 0x0);
      

      bool changeBrightness (byte val = 0x64);
      


      void changeBackground(bool newBackground = false);
      

      optVAL_t ID;
      private:
      

      

      byte pX;
      

      byte pY;
      

      bool _cI;

      

      void s2Cmd(optVAL_t o, optVAL_t t);
      

      bool s1Cmd(optVAL_t o);
      

      void s1Dat(optVAL_t o);

  };



    //-------------------------------------------------------------------------------------------------------------------------------------------------
    //                                                                definitions                                                                      
    //-------------------------------------------------------------------------------------------------------------------------------------------------

	#if EBOARD_NANO == 0x0
	LCD::LCD(SoccerBoard &soccerBoard, optVAL_t id) {
	    this->_cI = false;
	    this->ID = id;
	    //this->init();
	}
	#else
	LCD::LCD( optVAL_t id) {
	    this->_cI = false;
	    this->ID = id;
	    //this->init();
	}
	#endif

	bool LCD::changeID(optVAL_t newID) {
	    this->ID = newID;
	    return this->init();
	}
	bool LCD::clear(void) {
	  if(!this->_cI) this->init();
	    for(byte i = 0; i < 8; i++){
	        //maybe *8
	        setCursor(0,i);

	        for (byte j = 0; j < 128; j++)
	            this->s1Dat(0);
	    }
	    return setCursor(0,0);
	}
	void LCD::print(optVAL_t line, optVAL_t col, const char *data) {
	    if(!this->_cI) this->init();
	    byte i = 0x0;
	    if(col < ((LCD_WIDTH-1)/8.0) && line < ((LCD_HEIGHT-1)/8.0)) {
	        setCursor(col,line);
	    }
	    while(data[i] && (pX*8) < LCD_WIDTH){
	        //Serial.print(data[i]); Serial.print(" ");
	        //Serial.print(i); Serial.print(" "); Serial.print(pX); Serial.print(" ");
	        //Serial.println(this->pY);
	        if(data[i] == '\n' || this->pX >= LCD_WIDTH) {
	            setCursor(0,(pY+1));
	        } else if (this->pY >= LCD_HEIGHT){
	            setCursor(0,0);
	        }
	        if(data[i] < 32 || data[i] > 127){ i++; continue;}
	        for (byte j = 0; j < 8; j++){
	            this->s1Dat(pgm_read_byte(&basicFont[data[i]-32][j]));
	        }
	        i++;this->pX++;
	    }
	}
	void LCD::print(optVAL_t line, optVAL_t col, int data){
	    char buffer[11] = "";
	    itoa(data,buffer,10);
	    this->print(line,col,buffer);
	}
	void LCD::lightOn(void) {
	    this->changeBrightness(255);
	}
	void LCD::lightOff(void) {
	    this->changeBrightness(0);
	}
	bool LCD::reset(void) {
	    return this->clear();
	}
	void LCD::print(int data) {this->print(255,255,data);}
	void LCD::print(const char* data) {this->print(255,255,data);}
	bool LCD::init() {
	    #ifdef HIGHSPEED
	        TWBR = 0xC;
	    #endif
	        this->_cI = true;
	        this->s2Cmd(LCD_COMMAND_CHARGE_PUMP_SETTING,LCD_COMMAND_CHARGE_PUMP_ENABLE);
	        this->changeMode(false);
	        this->changeBackground(false);
	        this->changeBrightness(255);
	        this->s2Cmd(0x20,LCD_PAGE_ADDRESSING);
	        this->changeMode(true);

	        //this->print("eBoard \n written by \n EagleoutIce");
	        return this->clear();
	}

	void LCD::drawBitmap(const unsigned char *bitmap, byte posX, byte posY, byte hiX, byte hiY){
	    if(!this->_cI) this->init();
	    setCursor(posX,posY);
	    byte col = 0x0;
	    for(int i = 0x0; i < (hiX * 8 * hiY); i++){
	        this->s1Dat(pgm_read_byte(&bitmap[i]));
	        if(++col == (hiX * 8)) {
	            col = 0x0;
	            setCursor(posX,++posY);
	        }
	    }
	}
	void LCD::changeMode(bool newMode) {
	    if(!this->_cI) this->init();
	    if(newMode) this->s1Cmd(LCD_COMMAND_DISPLAY_ON);
	    else this->s1Cmd(LCD_COMMAND_DISPLAY_OFF);
	}
	bool LCD::setCursor(byte posX, byte posY) {
	    if(!this->_cI) this->init();
	    this->s2Cmd((0x00 + (8 *posX & 0x0F)),(0x10 + ((8 * posX >> 4) & 0x0F))); //lower and higher address
	    this->pX = posX; this->pY = posY;
	    return this->s1Cmd(0xB0 + posY);
	}

	bool LCD::changeBrightness(byte val) {
	    if(!this->_cI) this->init();
	    this->s2Cmd(0x81,val); //brightness mode
	    Wire.beginTransmission(this->ID);
	    return (Wire.endTransmission() == 0);
	}
	void LCD::changeBackground(bool newBackground) {
	    if(!this->_cI) this->init();
	    if(newBackground) this->s1Cmd(LCD_COMMAND_WHITE_BACKGROUND);
	    else this->s1Cmd(LCD_COMMAND_BLACK_BACKGROUND);
	}

	void LCD::s2Cmd(optVAL_t o, optVAL_t t){
	    if(!this->_cI) this->init();
	    this->s1Cmd(o); this->s1Cmd(t);
	}

	bool LCD::s1Cmd(optVAL_t C) {
	    if(!this->_cI) this->init();
	    Wire.beginTransmission(this->ID);
	    Wire.write(LCD_COMMAND_MODE); Wire.write(C);
	    return (Wire.endTransmission()==0);
	}
	void LCD::s1Dat(optVAL_t o){
	    if(!this->_cI) this->init();
	    Wire.beginTransmission(this->ID);
	    Wire.write(LCD_DATA_MODE); Wire.write(o);
	    Wire.endTransmission();
	}
	

#endif
